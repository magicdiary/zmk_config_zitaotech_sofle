## config/boards/shields/right_trackpoint/Kconfig.shield
```kconfig
# Copyright (c) 2022 The ZMK Contributors
# SPDX-License-Identifier: MIT

config SHIELD_RIGHT_TRACKPOINT
    def_bool $(shields_list_contains,right_trackpoint)

menu "TrackPoint Advanced Settings"

config TRACKPOINT_EXPONENTIAL
    bool "Enable TrackPoint exponential acceleration"
    default y
    help
      Enable exponential acceleration for TrackPoint movement,

config TRACKPOINT_SCROLL_X_DIR
    int "Scroll X direction multiplier (1 for normal, -1 for inverted)"
    default 1

config TRACKPOINT_SCROLL_Y_DIR
    int "Scroll Y direction multiplier (1 for normal, -1 for inverted)"
    default 1

config TRACKPOINT_SCROLL_DEADZONE
    int "Scroll deadzone"
    default 2
    help
      Deadzone to filter out slight hand tremors.

config TRACKPOINT_SCROLL_INPUT_MAX
    int "Scroll input max"
    default 128

config TRACKPOINT_SCROLL_DIVISOR_SLOW
    int "Scroll divisor slow (Fine-grained control)"
    default 60

config TRACKPOINT_SCROLL_DIVISOR_FAST
    int "Scroll divisor fast (Max speed limit)"
    default 8

config TRACKPOINT_DOMINANT_NUMERATOR
    int "Dominant axis numerator for accidental touch prevention"
    default 3

config TRACKPOINT_DOMINANT_DENOMINATOR
    int "Dominant axis denominator for accidental touch prevention"
    default 2

config TRACKPOINT_MOUSE_BASE_SPEED_PERCENT
    int "Mouse base speed (Percentage, 50 = 0.5)"
    default 50

config TRACKPOINT_MOUSE_SENS_BASE_PERCENT
    int "Mouse sensitivity base (Percentage, 30 = 0.3)"
    default 30

config TRACKPOINT_MOUSE_SENS_STEP_PERCENT
    int "Mouse sensitivity step per LED brightness (Percentage, 1 = 0.01)"
    default 1

config TRACKPOINT_MOUSE_GAIN_BASE_PERCENT
    int "Speed gain below the first gain threshold (Percentage, 60 = 0.6x)"
    default 60
    help
      Speed gain applied to light forces below
      TRACKPOINT_MOUSE_GAIN_L1_FORCE.

config TRACKPOINT_MOUSE_GAIN_L1_FORCE
    int "First gain threshold force reading"
    default 10
config TRACKPOINT_MOUSE_GAIN_L1_PERCENT
    int "Speed gain from the first threshold (Percentage, 80 = 0.8x)"
    default 80

config TRACKPOINT_MOUSE_GAIN_L2_FORCE
    int "Second gain threshold force reading"
    default 25
config TRACKPOINT_MOUSE_GAIN_L2_PERCENT
    int "Speed gain from the second threshold (Percentage, 150 = 1.5x)"
    default 150

config TRACKPOINT_MOUSE_GAIN_L3_FORCE
    int "Third gain threshold force reading"
    default 30
config TRACKPOINT_MOUSE_GAIN_L3_PERCENT
    int "Speed gain from the third threshold (Percentage, 183 = 1.83x)"
    default 183

config TRACKPOINT_MOUSE_GAIN_L4_FORCE
    int "Fourth gain threshold force reading"
    default 40
config TRACKPOINT_MOUSE_GAIN_L4_PERCENT
    int "Speed gain from the fourth threshold (Percentage, 250 = 2.5x)"
    default 250

config TRACKPOINT_MOUSE_GAIN_L5_FORCE
    int "Fifth gain threshold force reading"
    default 50
config TRACKPOINT_MOUSE_GAIN_L5_PERCENT
    int "Speed gain from the fifth threshold (Percentage, 300 = 3.0x)"
    default 300

endmenu
```
